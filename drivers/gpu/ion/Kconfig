## drivers/gpu/ion/Kconfig
```kconfig
menuconfig ION
	tristate "Ion Memory Manager"
	help
	  Chose this option to enable the ION Memory Manager.

config ION_OMAP
	tristate "Ion for OMAP"
	depends on ARCH_OMAP3 && ION
	help
	  Choose this option if you wish to use ion on OMAP4.
```

## drivers/video/omap2/Kconfig
```kconfig
config OMAP2_VRAM
	bool

config LATONA_EXPERIMENTAL
	bool 
        depends on MACH_SAMSUNG_LATONA
        default n
        help  
	  Experimental OMAP 3.0.y features on board-latona	

config OMAP2_VRFB
	bool
	depends on ARCH_OMAP2 || ARCH_OMAP3
	default y if FB_OMAP2
	help
	  OMAP VRFB buffer support is efficient for rotation

source "drivers/video/omap2/dss/Kconfig"
source "drivers/video/omap2/omapfb/Kconfig"
source "drivers/video/omap2/displays/Kconfig"
source "drivers/video/omap2/dsscomp/Kconfig"
```

## drivers/video/omap2/dsscomp/Kconfig
```kconfig
config DSSCOMP_DEBUG_LOG
	bool "Log event timestamps in debugfs"
	default y
	depends on DEBUG_FS

	help
	  Takes timestamp for each callback and state transition, and
	  logs the last 128 entries (last few frames' worth) in a
	  log buffer.  This is a separate menuconfig in case this is
	  deemed an overhead.

config OMAP3_ISP_RESIZER_ON_720P_VIDEO
	bool "ISP resizer used  for 720p video in DSSCOMP in OMAP3 (EXPERIMENTAL)"
	depends on EXPERIMENTAL && VIDEO_OMAP34XX_ISP_RESIZER
	default n
	help
	  Use ISP resizer on video buffers instead of DSS resizer.
	  Could increase performance of playing 720p clip but,
	  have some issues when record 720p with camera.
```
